## linux-mt/drivers/misc/mediatek/Kconfig
```kconfig
menu "Mediatek Peripherals "

source "drivers/misc/mediatek/usb20/Kconfig"
source "drivers/misc/mediatek/ice_debug/Kconfig"
source "drivers/misc/mediatek/trustzone/Kconfig"
source "drivers/misc/mediatek/ext_gic/Kconfig"
source "drivers/misc/mediatek/mtk_sdio/Kconfig"
source "drivers/misc/mediatek/ram_console/Kconfig"
source "drivers/misc/mediatek/aee/Kconfig"
source "drivers/misc/mediatek/emi/Kconfig"
source "drivers/misc/mediatek/sched/Kconfig"
source "drivers/misc/mediatek/base/Kconfig"
source "drivers/misc/mediatek/freqhopping/Kconfig"
source "drivers/misc/mediatek/thermal/Kconfig"
source "drivers/misc/mediatek/secure_efuse/Kconfig"

menu "Sensors"

config MTK_SENSOR_SUPPORT
	bool "MTK SENSOR SUPPORT"
	help
	  sensor config to sensor port sensor feature in project.

source "drivers/misc/mediatek/alsps/Kconfig"
source "drivers/misc/mediatek/hwmon/Kconfig"
endmenu  # Sensors
endmenu  # only USB
```
